## samples/bluetooth/mesh/dfu/common/Kconfig
```kconfig
# Copyright (c) 2026 Nordic Semiconductor ASA
# SPDX-License-Identifier: LicenseRef-Nordic-5-Clause

config MESH_DFU_SAMPLE_MEMFAULT_FWID
	bool "Use Memfault-oriented FWID format"
	help
	  Enables the Memfault-oriented FWID format with company ID, type byte (0xFF),
	  and variable-length hardware version, software version, and software type strings.

config MESH_DFU_SAMPLE_MEMFAULT_HW_VERSION
	string "Hardware version string reported to Memfault and encoded in the FWID"
	help
	  Hardware version string embedded verbatim in the Memfault-oriented FWID.

config MESH_DFU_SAMPLE_MEMFAULT_SW_TYPE
	string "Software type string reported to Memfault and encoded in the FWID"
	default "cpuapp"
	help
	  Memfault software type string embedded verbatim in the Memfault-oriented FWID.
```

## samples/bluetooth/mesh/dfu/target/Kconfig
```kconfig
# Copyright (c) 2026 Nordic Semiconductor ASA
# SPDX-License-Identifier: LicenseRef-Nordic-5-Clause

rsource "../common/Kconfig"

config MESH_DFU_SAMPLE_MEMFAULT_HW_VERSION
	default "$(BOARD)/target"

source "Kconfig.zephyr"
```

## subsys/bluetooth/mesh/Kconfig.rpl
```kconfig
#
# Copyright (c) 2022 Nordic Semiconductor ASA
#
# SPDX-License-Identifier: LicenseRef-Nordic-5-Clause
#

# Option enabled when the NCS implementation of RPL should be used instead of
# the Zephyr one.
config BT_MESH_RPL_NCS
	bool

choice BT_MESH_RPL_STORAGE_MODE
	prompt "Replay protection list storage mode"
	default BT_MESH_RPL_STORAGE_MODE_EMDS if EMDS

config BT_MESH_RPL_STORAGE_MODE_EMDS
	bool "Persistent storage of RPL in Emergency Data Storage"
	depends on EMDS
	select BT_MESH_RPL_NCS
	help
	  Persistent storage of RPL in Emergency Data Storage.

config BT_MESH_RPL_STORAGE_MODE_ZMS
	bool "Persistent storage of RPL in Zephyr Memory Storage"
	depends on ZMS
	depends on !ZMS_ID_64BIT
	depends on FLASH_PAGE_LAYOUT
	depends on FLASH_MAP
	select BT_MESH_RPL_NCS
	select BT_MESH_PENDING_STORE
	select CRC
	select EXPERIMENTAL
	help
	  Persistent storage of RPL directly in a dedicated ZMS partition.
	  This approach does not use the Settings subsystem for RPL storage.

	  The partition must be labeled rpl_partition. Its last sectors hold a
	  backup of the RPL, which keeps the RPL safe across a power loss while
	  it is rewritten after an IV Index update. The backup needs a header
	  plus 8 bytes per entry of BT_MESH_CRPL, rounded up to whole sectors.
	  ZMS uses the remaining sectors, and needs at least two of them.

endchoice

if BT_MESH_RPL_STORAGE_MODE_EMDS

config BT_MESH_RPL_INDEX
	int "Unique index for the storage of RPL data"
	default 999
	help
	  This value defines the storage index for the RPL data in Emergency
	  Data Storage, and can not overlap with any other index in the
	  Emergency Data Storage.

endif # BT_MESH_RPL_STORAGE_MODE_EMDS
```
